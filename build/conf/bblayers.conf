## build/conf/bblayers.conf
```bitbake
# POKY_BBLAYERS_CONF_VERSION is increased each time build/conf/bblayers.conf
# changes incompatibly
POKY_BBLAYERS_CONF_VERSION = "2"

BBPATH = "${TOPDIR}"
BBFILES ?= ""

BBLAYERS ?= " \
  /home/gokhan/yocto-labs/poky/meta \
  /home/gokhan/yocto-labs/poky/meta-poky \
  /home/gokhan/yocto-labs/poky/meta-yocto-bsp \
  /home/gokhan/yocto-labs/meta-ti/meta-ti-bsp \
  /home/gokhan/yocto-labs/meta-arm/meta-arm-toolchain \
  /home/gokhan/yocto-labs/meta-arm/meta-arm \
  /home/gokhan/yocto-labs/meta-bootlinlabs \
  "
```

## meta-bootlinlabs/conf/distro/kabanos.conf
```bitbake
require conf/distro/poky.conf

DISTRO = "kabanos"
DISTRO_NAME = "a podman based BBB OS"
DISTRO_VERSION = "0.1"
MAINTAINER = "Gyokhan Kochmarla <kabanos@gyokhan.com>"
```

## meta-bootlinlabs/conf/machine/bootlinlabs.conf
```bitbake
require conf/machine/include/ti-soc.inc

SOC_FAMILY:append = ":ti33x"
DEFAULTTUNE = "armv7athf-neon"

require conf/machine/include/ti33x.inc

PREFERRED_PROVIDER_virtual/kernel = "linux-bb.org"
KERNEL_DEVICETREE = 'ti/omap/am335x-boneblack.dtb'
PREFERRED_PROVIDER_virtual/bootloader = "u-boot-bb.org"
MACHINEOVERRIDES:append = ":beaglebone"
UBOOT_ARCH = "arm"
UBOOT_MACHINE = "am335x_evm_config"
UBOOT_ENTRYPOINT = "0x80008000"
UBOOT_LOADADDRESS = "0x80008000"
KERNEL_IMAGETYPE = "zImage"
SERIAL_CONSOLES = "115200;ttyS0 115200;ttyO0 115200;ttyAMA0"
MACHINE_FEATURES = "apm ext2 usbgadget usbhost vfat alsa"
IMAGE_FSTYPES = "tar.xz wic"
```
